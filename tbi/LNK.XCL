-D_R=0 
-Z(CODE)INTVEC,C_ICALL,RCODE,CONST,CCSTR,CSTR,CODE,X_CDATA,D_CDATA,I_CDATA,C_RECFN,RF_XDATA,c1=0
-Z(DATA)D_IDATA,D_UDATA,C_ARGD=8
-Z(IDATA)I_IDATA,I_UDATA,C_ARGI
-Z(IDATA)CSTACK
-Z(XDATA)X_UDATA,X_IDATA,C_ARGX,ECSTR=0
-Z(BIT)BITVARS,C_ARGB=20
-K
-R
-z
